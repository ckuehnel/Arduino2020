/*
 * ESP32_T5_v2.3_Node.ino
 * 
 * IoT node w/ T5_v2.3 including 2.13" ePaper display. The node is powered by 3.7 V LiPo (1000 mAh) or  
 * USB alternatively. The battery voltage is measured internally. 
 * A BMP280 is connected via I2C to measure temperature.
 * The measuring values are send each hour by Telegram
 * 
 * Based on https://github.com/Xinyuan-LilyGO/LilyGo-T5-ink-series/blob/master/LilyGo_T5_V2.3/LilyGo_T5_V2.3.ino
 * 
 * 2020-11-27 Claus Kuehnel info@ckuehnel.ch
 */

// include library, include base class, make path known
#include <GxEPD.h>
#include "SD.h"
#include "SPI.h"

//  There are three versions of the 2.13 screen,
//  if you are not sure which version, please test each one,
//  if it is successful then it belongs to the model of the file name
//  关于v2.3版本的显示屏版本,如果不确定购买的显示屏型号,请每个头文件都测试一遍.

//#include <GxGDE0213B1/GxGDE0213B1.h>      // 2.13" b/w
//#include <GxGDEH0213B72/GxGDEH0213B72.h>  // 2.13" b/w new panel
#include <GxGDEH0213B73/GxGDEH0213B73.h>  // 2.13" b/w newer panel

int bmpWidth = 150, bmpHeight = 39;      //width:150,height:39
const unsigned char lilygo[] = {0x00, 0x00, 0x00, 0x00, 0x00, 0x00, 0x00, 0x00, 0x00, 0x00, 0x00, 0x00, 0x00,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 0x00, 0x00};

// FreeFonts from Adafruit_GFX
#include <Fonts/FreeMonoBold9pt7b.h>
#include <Fonts/FreeMonoBold12pt7b.h>
#include <Fonts/FreeMonoBold18pt7b.h>
#include <Fonts/FreeMonoBold24pt7b.h>

#include <GxIO/GxIO_SPI/GxIO_SPI.h>
#include <GxIO/GxIO.h>

// WiFi connection 
#include <WiFi.h>
#include <WiFiClientSecure.h>
#include <UniversalTelegramBot.h>
#include "arduino_secrets.h"

WiFiClientSecure client;
UniversalTelegramBot bot(BOTtoken, client);

// SPI
#define SPI_MOSI 23
#define SPI_MISO -1
#define SPI_CLK 18

#define ELINK_SS 5
#define ELINK_BUSY 4
#define ELINK_RESET 16
#define ELINK_DC 17

#define SDCARD_SS 13
#define SDCARD_CLK 14
#define SDCARD_MOSI 15
#define SDCARD_MISO 2

//#define BUTTON_PIN 39

GxIO_Class io(SPI, /*CS=5*/ ELINK_SS, /*DC=*/ ELINK_DC, /*RST=*/ ELINK_RESET);
GxEPD_Class display(io, /*RST=*/ ELINK_RESET, /*BUSY=*/ ELINK_BUSY);

SPIClass sdSPI(VSPI);

// General
#define DEBUG 0   // enable/disable serial output
#define WIFI 1    // enable/disable WiFi connection

bool sdOK = false;
int startX = 20, startY = 5;

#define uS_TO_S_FACTOR 1000000  // Conversion factor for micro seconds to seconds 
#define TIME_TO_SLEEP  1800     // Time ESP32 will go to sleep (in seconds)

const int Vbat = 35;  // ADC1:7 @ GPIO35
const int LED  = 19;  // LED @ GPIO19

float voltage, temp;

void setup()
{
  if (DEBUG)
  {
    Serial.begin(115200);
    while(!Serial);

    print_wakeup_reason(); //Print the wakeup reason for ESP32
  
    Serial.print("Setup...");
  }
  SPI.begin(SPI_CLK, SPI_MISO, SPI_MOSI, ELINK_SS);
  display.init(); // enable diagnostic output on Serial

  initBMP280();

  pinMode(LED, OUTPUT);
  digitalWrite(LED, 1);
  delay(100);
  digitalWrite(LED,0);

  display.setRotation(1);
  display.fillScreen(GxEPD_WHITE);
  display.setTextColor(GxEPD_BLACK);
  display.setFont(&FreeMonoBold9pt7b);
  display.setCursor(0, 0);

  sdSPI.begin(SDCARD_CLK, SDCARD_MISO, SDCARD_MOSI, SDCARD_SS);

  if (!SD.begin(SDCARD_SS, sdSPI)) sdOK = false;
  else                             sdOK = true;

  if (DEBUG) Serial.println("done.");
    
  display.fillScreen(GxEPD_WHITE);
  display.setTextColor(GxEPD_BLACK);

  display.drawBitmap(lilygo, startX, startY,  bmpWidth, bmpHeight, GxEPD_BLACK);

  display.setCursor(display.width()   / 2 - 34, display.height() - 55);

  if (sdOK) 
  {
    uint32_t cardSize = SD.cardSize() / (1024 * 1024);
    display.println("SDCard:" + String(cardSize) + "MB");
  } else display.println("SDCard None");
    
  voltage = analogRead(Vbat) * 2 * 3.3/4096; // due to voltage divider
  delay(10);
  voltage = analogRead(Vbat) * 2 * 3.3/4096; // due to voltage divider
  display.setCursor(display.width() / 2 - 49, display.height() - 10);
  display.println("Vbat: " + String(voltage) + " V");
  if (DEBUG) Serial.println("Vbat: " + String(voltage) + " V");
  
  temp = temperatureRead(); // read internal sensor
  display.setCursor(10, display.height() - 40);
  display.println("Int. Temp.: " + String(temp) + " *C");
  if (DEBUG) Serial.println("Internal Temperature: " + String(temp) + " *C");

  temp = getTemperature(); // read external sensor
  display.setCursor(10, display.height() - 25);
  display.println("Ext. Temp.: " + String(temp) + " *C");
  if (DEBUG) Serial.println("External Temperature: " + String(temp) + " *C");
    
  display.update();

  if (WIFI) sendMessage();

  // goto sleep
  //esp_sleep_enable_ext0_wakeup((gpio_num_t)BUTTON_PIN, LOW);
  esp_sleep_enable_timer_wakeup(TIME_TO_SLEEP * uS_TO_S_FACTOR);
  if (DEBUG) Serial.println("Setup T5 to sleep for every " + String(TIME_TO_SLEEP) + " s.\n");

  esp_deep_sleep_start();
}

void loop() {}


// Method to print the reason by which ESP32 has been awaken from sleep
void print_wakeup_reason()
{
  esp_sleep_wakeup_cause_t wakeup_reason;
  wakeup_reason = esp_sleep_get_wakeup_cause();
  switch(wakeup_reason)
  {
    case ESP_SLEEP_WAKEUP_EXT0 :     Serial.println("\nWakeup caused by external signal using RTC_IO"); break;
    case ESP_SLEEP_WAKEUP_EXT1 :     Serial.println("\nWakeup caused by external signal using RTC_CNTL"); break;
    case ESP_SLEEP_WAKEUP_TIMER :    Serial.println("\nWakeup caused by timer"); break;
    case ESP_SLEEP_WAKEUP_TOUCHPAD : Serial.println("\nWakeup caused by touchpad"); break;
    case ESP_SLEEP_WAKEUP_ULP :      Serial.println("\nWakeup caused by ULP program"); break;
    default :                        Serial.printf("\nWakeup was not caused by deep sleep: %d\n",wakeup_reason); break;
  }
}
